## Kconfig
```kconfig
#
# For a description of the syntax of this configuration file,
# see Documentation/kbuild/kconfig-language.txt.
#
mainmenu "Linux/$ARCH $KERNELVERSION Kernel Configuration"

config SRCARCH
	string
	option env="SRCARCH"

config CUSTOM
	bool "Custom ROM support"
	default n
	help
	  Enable if you want to build custom ROM specific features

source "arch/$SRCARCH/Kconfig"
```

## arch/arm64/hotplugs/Kconfig
```kconfig
config ASMP
 	bool "Multi-core automatic hotplug support"
 	depends on SMP
 	default n
 	help
 	Automatically hotplugs the multiple cpu cores on and off
 	based on cpu load and suspend stat

          Note that this will BREAK any runtime patching of the kernel text
          (i.e. anything that uses apply_alternatives,
          aarch64_insn_patch_text_nosync, etc. including the various CPU
          errata workarounds in arch/arm64/kernel/cpu_errata.c).

	  For MPU based protection-enabled targets please refer to
	  MSM_KERNEL_PROTECT_MPU
```

## drivers/platform/xiaomi/Kconfig
```kconfig
# Xiaomi configuration options

config MACH_XIAOMI
	bool "Xiaomi device"
	depends on ARCH_MSM
	help
	  Support for Xiaomi products

config MACH_XIAOMI_MSM8953
	bool "Xiaomi MSM8953"
	depends on ARCH_MSM8953
	select MACH_XIAOMI
	help
	  Support for MSM8953 Xiaomi variants

config MACH_XIAOMI_VINCE
	bool "Vince board"
	select MACH_XIAOMI_MSM8953
	help
	  Support for Xiaomi Redmi 5 Plus (vince)
```
