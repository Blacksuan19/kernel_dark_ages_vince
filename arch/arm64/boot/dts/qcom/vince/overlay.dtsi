#include "vince-general.dtsi"
#include "vince-pinctrl.dtsi"
#include "vince-pm.dtsi"
#include "vince-regulator.dtsi"
#include "vince-audio.dtsi"
#include "vince-mdss.dtsi"
#include "vince-qrd.dtsi"
#include "vince-camera.dtsi"